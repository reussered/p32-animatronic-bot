## sdkconfig.defaults
```kconfig
# P32 Animatronic Bot - ESP32-S3 Configuration  
# Optimized for animatronic control with WiFi support

# Basic ESP32-S3 settings
CONFIG_ESP32S3_DEFAULT_CPU_FREQ_240=y

# Enable WiFi for remote control and updates
CONFIG_ESP_WIFI_ENABLED=y
CONFIG_ESP_WIFI_SOFTAP_SUPPORT=y
CONFIG_ESP_WIFI_STA_SUPPORT=y

# Disable Bluetooth to save resources
CONFIG_BT_ENABLED=n
CONFIG_BT_BLUEDROID_ENABLED=n
CONFIG_BT_NIMBLE_ENABLED=n

# Completely disable all compiler warnings as errors
CONFIG_COMPILER_DISABLE_GCC8_WARNINGS=y
CONFIG_COMPILER_DISABLE_GCC11_WARNINGS=y 
CONFIG_COMPILER_DISABLE_GCC12_WARNINGS=y
CONFIG_COMPILER_DISABLE_GCC13_WARNINGS=y
CONFIG_COMPILER_WARN_WRITE_STRINGS=n
CONFIG_COMPILER_OPTIMIZATION_ASSERTIONS_DISABLE=y
CONFIG_COMPILER_OPTIMIZATION_ASSERTION_LEVEL=0
CONFIG_LOG_DEFAULT_LEVEL_NONE=n
CONFIG_LOG_DEFAULT_LEVEL_ERROR=n
CONFIG_LOG_DEFAULT_LEVEL_WARN=n

# Disable network components we don't need
CONFIG_LWIP_IPV6=n
CONFIG_LWIP_NETIF_LOOPBACK=n

# WPA Supplicant specific configuration to avoid redefinition warnings
CONFIG_WPA_SUPPRESS_BSS_SCAN_HISTORY=y

# Enable required components for animatronics
CONFIG_SPI_MASTER_ISR_IN_IRAM=y
CONFIG_SPI_MASTER_IN_IRAM=y
CONFIG_I2S_ENABLE_DEBUG_LOG=n

# Optimize for animatronic performance
CONFIG_ESP_TASK_WDT_CHECK_IDLE_TASK_CPU0=n
CONFIG_ESP_TASK_WDT_CHECK_IDLE_TASK_CPU1=n
CONFIG_ESP_SYSTEM_CHECK_INT_LEVEL_4=n

# Serial output optimization
CONFIG_ESP_CONSOLE_UART_BAUDRATE=115200
```
